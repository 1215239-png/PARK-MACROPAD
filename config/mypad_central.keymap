#include <behaviors.dtsi>
#include <dt-bindings/zmk/keys.h>

/ {
    keymap {
        compatible = "zmk,keymap";

        default_layer {
            bindings = <
                &kp LC(LA(S))    &kp LG(LS(S))    &kp LG(N1)    &kp C_PP
            >;
            sensor-bindings = <&inc_dec_kp C_VOL_DN C_VOL_UP>;
        };
    };
};
