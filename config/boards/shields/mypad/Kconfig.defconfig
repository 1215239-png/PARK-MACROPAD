## config/boards/shields/mypad/Kconfig.defconfig
```kconfig
if SHIELD_MYPAD_CENTRAL || SHIELD_MYPAD_PERIPHERAL
    config ZMK_SPLIT
        default y
endif
```

## config/boards/shields/mypad/Kconfig.shield
```kconfig
config SHIELD_MYPAD_CENTRAL
    def_bool $(shields_list_contains,mypad_central)
config SHIELD_MYPAD_PERIPHERAL
    def_bool $(shields_list_contains,mypad_peripheral)
```
